#INCLUDE<P16F877A.inc>

VALOR1 EQU H'51'
VALOR2 EQU H'52'
VALOR3 EQU H'53'

CTE2 EQU .2
CTE3 EQU .82

TIME EQU 0x20	 	;Dirección que determinará el tiempo en milisegundos

org 0
goto INICIO
org 5

INICIO:
	CLRF PORTA		;Limpiamos PORTA
	BSF STATUS,RP0	
	BCF STATUS,RP1	;Cambiamos al banco 1
	MOVLW h'0'		
	MOVWF TRISB		;Establecemos al PORTB como salida
	CLRF PORTB		;Limpiamos el puerto B
	MOVLW 0x06		
	MOVWF ADCON1	;Puerto Ay E como digitales
	MOVLW 0x3f
	MOVWF TRISA		;Puerto A como entrada
	BCF STATUS,RP0	;Regresamos al banco 0 

CICLO:
	MOVLW 0x04			;W <- PORTA 
	SUBWF PORTA,W		;W <- 0x04 - PORTA
	BTFSS STATUS,Z		;¿STATUS[Z]==1?, PORTA == 0x04
	GOTO GIRO_90_0
GIRO_0:
	MOVLW 0x01		
	MOVWF PORTB		;(PORTB) <- 00000001
	MOVLW .5		;1ms
	MOVWF TIME		;(TIME) <- 0x01		
	CALL RETARDO		
	CLRF PORTB		;(PORTB) <- 0
	MOVLW .190		;19 ms
	MOVWF TIME		;Tiempo en bajo
	CALL RETARDO
	GOTO CICLO
GIRO_90_0:
	MOVLW 0x02
	SUBWF PORTA,W	;W <- PORTA - 0x02
	BTFSS STATUS,Z	;STATUS[Z] == 1, 
	GOTO COMP_180
GIRO_90:
	MOVLW 0x01		
	MOVWF PORTB		;(PORTB) <- 00000001
	MOVLW .15		;1,5ms
	MOVWF TIME		;(TIME) <- 0x01		
	CALL RETARDO	
	CLRF PORTB		;(PORTB) <- 0
	MOVLW .185		;18,5ms
	MOVWF TIME		;Tiempo en bajo
	CALL RETARDO
	GOTO CICLO

COMP_180:
	MOVLW 0x01
	SUBWF PORTA,W	;W <- PORTA - 0x01
	BTFSS STATUS,Z	;¿PORTA == 0x01?, ¿Z==1?
	GOTO CICLO
GIRO_180:
	MOVLW 0x01		
	MOVWF PORTB		;(PORTB) <- 00000001
	MOVLW .20		;2 ms
	MOVWF TIME		;(TIME) <- 0x01		
	CALL RETARDO	
	CLRF PORTB		;(PORTB) <- 0
	MOVLW .180		;18 5ms
	MOVWF TIME		;Tiempo en bajo
	CALL RETARDO
	GOTO CICLO


RETARDO:
	MOVF TIME,W		;Configuración del tiempo
	MOVWF VALOR1
TRES:
	MOVLW CTE2	
	MOVWF VALOR2
DOS:
	MOVLW CTE3
	MOVWF VALOR3
UNO:
	DECFSZ VALOR3
	GOTO UNO
	DECFSZ VALOR2
	GOTO DOS
	DECFSZ VALOR1
	GOTO TRES
	RETURN
	
	END